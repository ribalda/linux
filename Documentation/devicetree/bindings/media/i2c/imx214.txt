## Documentation/devicetree/bindings/media/i2c/imx214.txt
```
* Sony 1/3.06-Inch 13.13Mp CMOS Digital Image Sensor

The Sony imx214 is a 1/3.06-inch CMOS active pixel digital image sensor with
an active array size of 4224H x 3200V. It is programmable through an I2C
interface. The I2C address can be configured to to 0x1a or 0x10, depending on
how the hardware is wired.
Image data is sent through MIPI CSI-2, which is configured as 4 lanes
at 1440 Mbps.


Required Properties:
- compatible: value should be "sony,imx214" for imx214 sensor
- reg: I2C bus address of the device
- enable-gpios: GPIO descriptor for the enable pin.
- vdddo-supply: Chip digital IO regulator (1.8V).
- vdda-supply: Chip analog regulator (2.7V).
- vddd-supply: Chip digital core regulator (1.12V).
- clocks = Reference to the xclk clock.
- clock-names = Clock name, e.g. "xclk".
- clock-frequency = Frequency of the xclk clock. (Currently the
	driver only supports <24000000>).

Optional Properties:
- flash-leds: See ../video-interfaces.txt
- lens-focus: See ../video-interfaces.txt

The imx274 device node should contain one 'port' child node with
an 'endpoint' subnode. For further reading on port node refer to
Documentation/devicetree/bindings/media/video-interfaces.txt.

Example:

	camera_rear@1a {
		compatible = "sony,imx214";
		reg = <0x1a>;
		vdddo-supply = <&pm8994_lvs1>;
		vddd-supply = <&camera_vddd_1v12>;
		vdda-supply = <&pm8994_l17>;
		lens-focus = <&ad5820>;
		enable-gpios = <&msmgpio 25 GPIO_ACTIVE_HIGH>;
		clocks = <&mmcc CAMSS_MCLK0_CLK>;
		clock-names = "xclk";
		clock-frequency = <24000000>;
		port {
			imx214_ep: endpoint {
				clock-lanes = <0>;
				data-lanes = <1 2 3 4>;
				link-frequencies = /bits/ 64 <480000000>;
				remote-endpoint = <&csiphy0_ep>;
			};
		};
	};
```

## Documentation/devicetree/bindings/mtd/mtd,gpio-addr-flash.txt
```
Memory Mapped flash with some address lines addressed using GPIOs

Handle the case where a flash device is mostly addressed using physical
line and supplemented by GPIOs.  This way you can hook up say a 8MiB flash
to a 2MiB memory range and use the GPIOs to select a particular range.

 - compatible :  must be "mtd,gpio-addr-flash", "cfi-flash";
 - reg : Address range of the mtd chip that is memory mapped, this is,
   on the previous example 2MiB.
 - addr-gpios: List of GPIO specifiers that will be used to address the MSBs
   address lines. The order goes from LSB to MSB.

For the rest of the properties, see mtd-physmap.txt.

The device tree may optionally contain sub-nodes describing partitions of the
address space. Check partition.txt for more details.

Example:

	flash@300000 {
		compatible = "mtd,gpio-addr-flash", "cfi-flash";
		bank-width = <2>;
		reg = < 0x00300000 0x00200000 >;
		addr-gpios = <&gpio_0 3 0>, <&gpio_0 4 0>;
	} ;
```

## drivers/tty/serdev/Kconfig
```kconfig
#
# Serial bus device driver configuration
#
menuconfig SERIAL_DEV_BUS
	tristate "Serial device bus"
	help
	  Core support for devices connected via a serial port.

	  Note that you typically also want to enable TTY port controller support.

if SERIAL_DEV_BUS

config SERIAL_DEV_CTRL_TTYPORT
	bool "Serial device TTY port controller"
	help
	  Say Y here if you want to use the Serial device bus with common TTY
	  drivers (e.g. serial drivers).

	  If unsure, say Y.
	depends on TTY
	depends on SERIAL_DEV_BUS != m
	default y

config SERIAL_DEV_CTRL_TTYDEV
	tristate "TTY port dynamically loaded by the Serial Device Bus"
	help
	  Say Y here if you want to create a bridge driver between the Serial
	  device bus and the TTY chardevice. This driver can be dynamically
	  loaded/unloaded by the Serial Device Bus.

	  If unsure, say N.
	depends on SERIAL_DEV_CTRL_TTYPORT

endif
```
